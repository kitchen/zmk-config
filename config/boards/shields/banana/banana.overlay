#include <dt-bindings/zmk/matrix_transform.h>

/ {
    chosen {
        zmk,kscan = &kscan0;
        zmk,matrix_transform = &default_transform;
    };
    default_transform: keymap_transform_0 {
        compatible = "zmk,matrix-transform";
    columns = <8>;
    rows = <1>;
    map = <
        RC(0,0) RC(0,1) RC(0,2) RC(0,3) RC(0,4) RC(0,5) RC(0,6) RC(0,7)
    >;
};

	kscan0: kscan {
		compatible = "zmk,kscan-gpio-direct";
		label = "KSCAN";
		input-gpios
    		= <&xiao_d  6 (GPIO_ACTIVE_LOW | GPIO_PULL_UP)>
    		, <&xiao_d  5 (GPIO_ACTIVE_LOW | GPIO_PULL_UP)>
    		, <&xiao_d  4 (GPIO_ACTIVE_LOW | GPIO_PULL_UP)>
    		, <&xiao_d  3 (GPIO_ACTIVE_LOW | GPIO_PULL_UP)>
    		, <&xiao_d 10 (GPIO_ACTIVE_LOW | GPIO_PULL_UP)>
    		, <&xiao_d  9 (GPIO_ACTIVE_LOW | GPIO_PULL_UP)>
    		, <&xiao_d  8 (GPIO_ACTIVE_LOW | GPIO_PULL_UP)>
    		, <&xiao_d  7 (GPIO_ACTIVE_LOW | GPIO_PULL_UP)>
    		;
	};
};

