## config/boards/shields/banana/Kconfig.defconfig
```kconfig
if SHIELD_BANANA

config ZMK_KEYBOARD_NAME
    default "banana macropad"

config ZMK_USB
    default y

endif
```

## config/boards/shields/ffkb/Kconfig.defconfig
```kconfig
# Copyright (c) 2021 The ZMK Contributors
# SPDX-License-Identifier: MIT

if SHIELD_FFKB

config ZMK_KEYBOARD_NAME
    default "ffkb"

CONFIG_BUILD_OUTPUT_UF2=y

endif
```

## config/boards/shields/naked48/Kconfig.shield
```kconfig
# Copyright (c) 2021 Jeremy Kitchen
# SPDX-License-Identifier: MIT

config SHIELD_NAKED48
       def_bool $(shields_list_contains,naked48)
```

## config/boards/shields/pdxkbc_macropad_promicro/Kconfig.defconfig
```kconfig
if SHIELD_PDXKBC_MACROPAD

config ZMK_KEYBOARD_NAME
    default "PDXKBC Macropad"
    
endif
```

## config/boards/shields/pdxkbc_macropad_promicro/Kconfig.shield
```kconfig
config SHIELD_PDXKBC_MACROPAD
    def_bool $(shields_list_contains,pdxkbc_macropad)
```

## config/boards/shields/reviung34/Kconfig.defconfig
```kconfig
if SHIELD_REVIUNG34

config ZMK_KEYBOARD_NAME
    default "reviung34"

config ZMK_USB
    default y

endif
```

## config/west.yml
```yaml
manifest:
  remotes:
    - name: zmkfirmware
      url-base: https://github.com/zmkfirmware
    - name: kitchen
      url-base: https://github.com/kitchen
    - name: ebastler
      url-base: https://github.com/ebastler
    # Additional modules containing boards/shields/custom code can be listed here as well
    # See https://docs.zephyrproject.org/3.2.0/develop/west/manifest.html#projects
  projects:
    - name: zmk
      remote: zmkfirmware
      revision: main
      import: app/west.yml
    - name: nicehatharry
      remote: kitchen
      clone-depth: 1
      revision: kitchen/zmk-shield
    - name: zmk-cornholius
      remote: kitchen
      clone-depth: 1
      revision: main
    - name: reviung34-zmk
      remote: kitchen
      clone-depth: 1
      revision: main
  self:
    path: config
```
