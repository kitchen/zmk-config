/* the zaphod is what got me down to my "standard keymap" so no need for
 * a matrix transform or any other funny business here!
 */
#include "standard-keymap.keymap"

&kscan {
    debounce-period = <10>;
};
